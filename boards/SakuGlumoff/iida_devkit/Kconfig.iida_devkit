## boards/SakuGlumoff/iida_devkit/board.yml
```yaml
board:
  name: iida_devkit
  full_name: Iida devkit
  vendor: SakuGlumoff
  revision:
    format: major.minor.patch
    default: 6.0.0
    exact: true
    revisions:
      - name: 6.0.0
      - name: 6.1.0
  socs:
    - name: stm32l552xx
```

## drivers/Kconfig
```kconfig
menu "Drivers"
rsource "max17048g/Kconfig"
rsource "mcp9808/Kconfig"
rsource "sht40/Kconfig"
endmenu
```

## drivers/max17048g/Kconfig
```kconfig
config MAX17048G
	bool "MAX17048G Battery monitor"
	default y
	select i2c
	select gpio
	help
	  Enable support for the MAX17048G battery monitor.
```

## drivers/mcp9808/Kconfig
```kconfig
config MCP9808
	bool "MCP9808 Temperature Sensor"
	default y
	select i2c
	select gpio
	help
	  Enable support for the MCP9808 temperature sensor.
```

## drivers/sht40/Kconfig
```kconfig
config SHT40
	bool "SHT40 Humidity sensor"
	default y
	select i2c
	select gpio
	help
	  Enable support for the SHT40 humidity sensor.
```

## dts/bindings/dummy-gpio.yaml
```yaml
description: A dummy GPIO pin

compatible: "dummy-gpio"

properties:
  gpios:
    type: phandle-array
    required: true
    description: The GPIO used as a dummy pin.
```

## dts/bindings/hwid.yaml
```yaml
description: |
  A hardware ID GPIO pin that reads the GPIO level defined in input-gpios.

  Example definition in devicetree:

    hwid {
        compatible = "hwid";
        hwid1 {
          label = "HWID1";
          gpios = <&gpioa 0 (GPIO_OPEN_DRAIN | GPIO_ACTIVE_HIGH)>;
        };
        hwid2 {
          label = "HWID2";
          gpios = <&gpioa 1 (GPIO_OPEN_DRAIN | GPIO_ACTIVE_HIGH)>;
        };
    };

compatible: "hwid"

child-binding:
  description: GPIO HWID child node
  properties:
    gpios:
      type: phandle-array
      required: true
    label:
      type: string
      description: |
        Human readable string describing the HWID pin. It can be used by an
        application to identify this HWID pin or to retrieve its number/index
        (i.e. child node number) on the parent device.
```

## west.yml
```yaml
manifest:
  remotes:
    - name: zephyrproject-rtos
      url-base: https://github.com/zephyrproject-rtos
  projects:
    - name: zephyr
      remote: zephyrproject-rtos
      revision: v4.4.1
      import:
        name-allowlist:
          - cmsis_6
          - hal_stm32
          - segger
  self:
    path: application
```
