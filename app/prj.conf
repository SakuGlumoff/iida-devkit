## CMakeLists.txt
```
cmake_minimum_required(VERSION 3.20.0)
find_package(Zephyr REQUIRED HINTS $ENV{ZEPHYR_BASE})

project(app
	LANGUAGES C CXX
)

target_sources(app PRIVATE
	${CMAKE_CURRENT_SOURCE_DIR}/main.c
	${CMAKE_CURRENT_SOURCE_DIR}/usbd_init.c
)

target_include_directories(app PRIVATE
	${CMAKE_CURRENT_SOURCE_DIR}/include
)
```

## Kconfig
```
menu "Iida devkit application"
source "Kconfig.zephyr"
endmenu

module = APP
module-str = app
source "subsys/logging/Kconfig.template.log_config"
```

## sample.yaml
```
sample:
  description: Iida devkit application
  name: iida-devkit-app
common:
  build_only: true
  integration_platforms:
    - iida_devkit
tests:
  app.default: {}
  app.debug:
    extra_overlay_confs:
      - debug.conf
```

## prj.conf
```kconfig
# Logging settings
CONFIG_LOG=y
CONFIG_CBPRINTF_FP_SUPPORT=y

CONFIG_SHELL=y
CONFIG_SHELL_CMDS=y
CONFIG_SHELL_TAB=y
CONFIG_SHELL_HELP=y
CONFIG_SHELL_HISTORY=y
CONFIG_GPIO_SHELL=y
CONFIG_I2C_SHELL=y
CONFIG_SENSOR_SHELL=y
CONFIG_FLASH_SHELL=y
CONFIG_EEPROM_SHELL=y

CONFIG_USBD_LOG_LEVEL_WRN=y
CONFIG_USBD_CDC_ACM_LOG_LEVEL_OFF=y

# Networking
CONFIG_NETWORKING=y
CONFIG_NET_NATIVE=y
CONFIG_NET_L2_PPP=y
CONFIG_NET_IPV4=y
CONFIG_NET_UDP=y
CONFIG_NET_SOCKETS=y
CONFIG_DNS_RESOLVER=y
CONFIG_NET_L2_PPP_OPTION_DNS_USE=y
CONFIG_NET_MGMT=y
CONFIG_NET_MGMT_EVENT=y
CONFIG_NET_CONNECTION_MANAGER=y
CONFIG_NET_SHELL=y

# Modem
CONFIG_REGULATOR=y
CONFIG_MODEM=y
CONFIG_PM_DEVICE=y
CONFIG_MODEM_CELLULAR=y
CONFIG_MODEM_CELLULAR_APN="internet"
CONFIG_MAIN_STACK_SIZE=2048
```

## debug.conf
```kconfig
# Debug configuration settings

# Make it a debug build
CONFIG_DEBUG_OPTIMIZATIONS=y

# Enable logging
CONFIG_LOG=y
CONFIG_APP_LOG_LEVEL_DBG=y
```

## src/main.c
```c
#include <zephyr/kernel.h>
#include <zephyr/app_version.h>
#include <zephyr/version.h>
#include <zephyr/autoconf.h>
#include <zephyr/device.h>
#include <zephyr/drivers/gpio.h>
#include <zephyr/usb/usbd.h>

#include "main.h"
#include "usbd_init.h"

#include <zephyr/logging/log.h>
LOG_MODULE_REGISTER(app, CONFIG_APP_LOG_LEVEL);

static const struct gpio_dt_spec ledA = GPIO_DT_SPEC_GET(DT_NODELABEL(led_a), gpios);

static struct usbd_context *sample_usbd;

static void usbd_cb(struct usbd_context *const ctx, const struct usbd_msg *msg)
{
	LOG_DBG("USBD message: %s", usbd_msg_type_string(msg->type));

	if (usbd_can_detect_vbus(ctx)) {
		if (msg->type == USBD_MSG_VBUS_READY) {
			if (usbd_enable(ctx)) {
				LOG_ERR("Failed to enable device support");
			}
		}

		if (msg->type == USBD_MSG_VBUS_REMOVED) {
			if (usbd_disable(ctx)) {
				LOG_ERR("Failed to disable device support");
			}
		}
	}
}

static int enable_usb_device_next(void)
{
	int err;

	sample_usbd = usbd_init_device(usbd_cb);
	if (sample_usbd == NULL) {
		LOG_ERR("Failed to initialize USB device");
		return -ENODEV;
	}

	if (!usbd_can_detect_vbus(sample_usbd)) {
		err = usbd_enable(sample_usbd);
		if (err) {
			LOG_ERR("Failed to enable device support");
			return err;
		}
	}

	LOG_DBG("USB device support enabled");

	return 0;
}

int main(void)
{
	LOG_INF("Iida devkit application: %s %s", APP_VERSION_STRING, STRINGIFY(APP_BUILD_VERSION));
	LOG_INF("Zephyr: %s", STRINGIFY(BUILD_VERSION));
	LOG_INF("Board: %s", CONFIG_BOARD_TARGET);
	LOG_INF("Built on %s @ %s", __DATE__, __TIME__);

	int err = 0;
	err = gpio_pin_configure_dt(&ledA, GPIO_OUTPUT_ACTIVE);
	if (err) {
		LOG_ERR("Error configuring LED A: %d", err);
		return err;
	}

	err = enable_usb_device_next();
	if (err != 0) {
		LOG_ERR("Failed to enable USB device support");
		return 0;
	}

	while (1) {
		err = gpio_pin_toggle_dt(&ledA);
		if (err) {
			LOG_ERR("Error toggling LED A: %d", err);
		}
		k_msleep(1000);
	}
}
```

## include/main.h
```c
#pragma once

#define SELF_TEST
```

## include/usbd_init.h
```c
#pragma once

#include <zephyr/usb/usbd.h>

struct usbd_context *usbd_init_device(usbd_msg_cb_t msg_cb);
```

## src/debug.c
```c
#include "debug.h"

#include <zephyr/logging/log.h>
#include <zephyr/device.h>
#include <zephyr/drivers/gpio.h>

LOG_MODULE_REGISTER(debug, CONFIG_APP_LOG_LEVEL);

#if DT_NODE_EXISTS(DT_NODELABEL(dbg_gpio))
static const struct gpio_dt_spec dbg_gpio = GPIO_DT_SPEC_GET_OR(DT_NODELABEL(dbg_gpio), gpios, {0});
#endif

#if DT_NODE_EXISTS(DT_NODELABEL(dbg_led_a))
static const struct gpio_dt_spec dbg_led_a =
	GPIO_DT_SPEC_GET_OR(DT_NODELABEL(dbg_led_a), gpios, {0});
#endif

#if DT_NODE_EXISTS(DT_NODELABEL(dbg_led_b))
static const struct gpio_dt_spec dbg_led_b =
	GPIO_DT_SPEC_GET_OR(DT_NODELABEL(dbg_led_b), gpios, {0});
#endif

#if DT_NODE_EXISTS(DT_NODELABEL(dbg_led_c))
static const struct gpio_dt_spec dbg_led_c =
	GPIO_DT_SPEC_GET_OR(DT_NODELABEL(dbg_led_c), gpios, {0});
#endif

static bool debug_gpio_okay = true;
static bool debug_led_a_okay = true;
static bool debug_led_b_okay = true;
static bool debug_led_c_okay = true;

void debug_init(void)
{
	int status = 0;

#if DT_NODE_EXISTS(DT_NODELABEL(dbg_gpio))
	if (!gpio_is_ready_dt(&dbg_gpio)) {
		LOG_ERR("DBG GPIO not ready");
		debug_gpio_okay = false;
	}
	if (debug_gpio_okay) {
		status = gpio_pin_configure_dt(&dbg_gpio, GPIO_OUTPUT_INACTIVE);
		if (status < 0) {
			LOG_ERR("Could not configure DBG GPIO");
			debug_gpio_okay = false;
		}
	}
#endif

#if DT_NODE_EXISTS(DT_NODELABEL(dbg_led_a))
	status = gpio_pin_configure_dt(&dbg_led_a, GPIO_OUTPUT_INACTIVE);
	if (status < 0) {
		debug_led_a_okay = false;
	}
#endif

#if DT_NODE_EXISTS(DT_NODELABEL(dbg_led_b))
	status = gpio_pin_configure_dt(&dbg_led_b, GPIO_OUTPUT_INACTIVE);
	if (status < 0) {
		debug_led_b_okay = false;
	}
#endif

#if DT_NODE_EXISTS(DT_NODELABEL(dbg_led_c))
	status = gpio_pin_configure_dt(&dbg_led_c, GPIO_OUTPUT_INACTIVE);
	if (status < 0) {
		debug_led_c_okay = false;
	}
#endif
}

void debug_gpio_set(bool state)
{
	if (!debug_gpio_okay) {
		return;
	}
	(void)gpio_pin_set_dt(&dbg_gpio, state ? 1 : 0);
}

void debug_gpio_toggle()
{
	if (!debug_gpio_okay) {
		return;
	}
	(void)gpio_pin_toggle_dt(&dbg_gpio);
}

void debug_led_set(enum dbg_led led, bool state)
{
	switch (led) {
	case DBG_LED_A:
		if (!debug_led_a_okay) {
			break;
		}
		(void)gpio_pin_set_dt(&dbg_led_a, state ? 1 : 0);
		break;
	case DBG_LED_B:
		if (!debug_led_b_okay) {
			break;
		}
		(void)gpio_pin_set_dt(&dbg_led_b, state ? 1 : 0);
		break;
	case DBG_LED_C:
		if (!debug_led_c_okay) {
			break;
		}
		(void)gpio_pin_set_dt(&dbg_led_c, state ? 1 : 0);
		break;
	default:
		LOG_ERR("Unknown LED");
		break;
	}
}

void debug_led_toggle(enum dbg_led led)
{
	switch (led) {
	case DBG_LED_A:
		if (!debug_led_a_okay) {
			break;
		}
		(void)gpio_pin_toggle_dt(&dbg_led_a);
		break;
	case DBG_LED_B:
		if (!debug_led_b_okay) {
			break;
		}
		(void)gpio_pin_toggle_dt(&dbg_led_b);
		break;
	case DBG_LED_C:
		if (!debug_led_c_okay) {
			break;
		}
		(void)gpio_pin_toggle_dt(&dbg_led_c);
		break;
	default:
		LOG_ERR("Unknown LED");
		break;
	}
}
```
